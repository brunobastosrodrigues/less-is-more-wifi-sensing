## firmware/esp-idf/main/Kconfig.projbuild
```kconfig
menu "WiFi Tomography Node Configuration"

    config WIFI_SSID
        string "WiFi SSID"
        default "your_wifi_ssid"
        help
            WiFi network name (SSID) to connect to.

    config WIFI_PASSWORD
        string "WiFi Password"
        default "your_wifi_password"
        help
            WiFi password (WPA2-PSK).

    config SERVER_IP
        string "Server IP Address"
        default "192.168.1.100"
        help
            IP address of the WiFi tomography server.

    config SERVER_PORT
        int "Server UDP Port"
        default 5000
        help
            UDP port for sending HELLO/HEARTBEAT/CSI data.

    config TRIGGER_PORT
        int "Trigger Listen Port"
        default 5001
        help
            UDP port for receiving TRIGGER commands.

    config BURST_PORT
        int "Burst Broadcast Port"
        default 5555
        help
            UDP port for sending burst packets during TX mode.

    config WIFI_CHANNEL
        int "Preferred WiFi Channel"
        range 0 13
        default 11
        help
            Preferred WiFi channel for CSI consistency (0 = auto).
            All nodes should use the same channel for best results.

    config BURST_COUNT
        int "Burst Packet Count"
        range 10 500
        default 100
        help
            Number of broadcast packets to send during TX burst.

    config BURST_DELAY_US
        int "Burst Inter-Packet Delay (microseconds)"
        range 0 10000
        default 500
        help
            Delay between burst packets in microseconds.

    config DEBUG_VERBOSE
        bool "Enable verbose debug logging"
        default y
        help
            Enable detailed logging for debugging connectivity issues.

endmenu
```

## firmware/esp-idf/sdkconfig.defaults
```kconfig
# WiFi Tomography Node - Default Configuration
# Use 'idf.py menuconfig' to customize these settings

# WiFi CSI (Channel State Information) - Required
CONFIG_ESP_WIFI_CSI_ENABLED=y

# WiFi Connection Settings (CHANGE THESE)
CONFIG_WIFI_SSID="your_wifi_ssid"
CONFIG_WIFI_PASSWORD="your_wifi_password"

# Server Settings (CHANGE THIS to your backend server IP)
CONFIG_SERVER_IP="192.168.1.100"
CONFIG_SERVER_PORT=5000
CONFIG_TRIGGER_PORT=5001
CONFIG_BURST_PORT=5555

# WiFi Channel (11 for consistent CSI across all nodes)
CONFIG_WIFI_CHANNEL=11

# CSI Burst Settings
CONFIG_BURST_COUNT=20
CONFIG_BURST_DELAY_US=200

# Debug logging (disable for production)
CONFIG_DEBUG_VERBOSE=y

# Performance Optimizations
CONFIG_ESP_WIFI_STATIC_RX_BUFFER_NUM=16
CONFIG_ESP_WIFI_DYNAMIC_RX_BUFFER_NUM=64
CONFIG_ESP_WIFI_RX_BA_WIN=16

# Logging - Enable INFO level for debugging
CONFIG_LOG_DEFAULT_LEVEL_INFO=y
CONFIG_LOG_MAXIMUM_LEVEL_VERBOSE=y

# Stack Sizes
CONFIG_ESP_MAIN_TASK_STACK_SIZE=4096
CONFIG_FREERTOS_IDLE_TASK_STACKSIZE=2048

# Partition table
CONFIG_PARTITION_TABLE_SINGLE_APP=y

# =============================================================================
# Performance Optimizations (OPT-8)
# =============================================================================

# Compiler: Optimize for performance (-O2)
CONFIG_COMPILER_OPTIMIZATION_PERF=y

# FreeRTOS: 1ms tick for precise timing
CONFIG_FREERTOS_HZ=1000

# WiFi: Disable unused features to reduce code size
CONFIG_ESP_WIFI_SOFTAP_SUPPORT=n
CONFIG_ESP_WIFI_ENTERPRISE_SUPPORT=n

# WiFi TX: Use static buffers for lower latency
CONFIG_ESP_WIFI_TX_BUFFER=1
CONFIG_ESP_WIFI_STATIC_TX_BUFFER_NUM=16

# Log level: INFO in production (DEBUG hidden unless menuconfig changed)
CONFIG_LOG_DEFAULT_LEVEL_INFO=y
```
